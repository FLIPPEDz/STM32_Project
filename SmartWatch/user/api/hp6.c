#include "hp6.h"
//CRC校验表
const uint16_t crc16_tab[256] =
{
	0x0000, 0xC0C1, 0xC181, 0x0140, 0xC301, 0x03C0, 0x0280, 0xC241,   
	0xC601, 0x06C0, 0x0780, 0xC741, 0x0500, 0xC5C1, 0xC481, 0x0440,   
	0xCC01, 0x0CC0, 0x0D80, 0xCD41, 0x0F00, 0xCFC1, 0xCE81, 0x0E40,   
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	0x8201, 0x42C0, 0x4380, 0x8341, 0x4100, 0x81C1, 0x8081, 0x4040 
};
//开启血压测量
const uint8_t BP_Open[]=
{0xc8,0xd7,0xb6,0xa5,0x90,0x01,0x00,0x00,
0x00,0x00,0x00,0x00,0x00,0x00,0x00,0x00,
0x00,0x00,0x00,0x00,0x00,0x00,0x00,0x00};

//关闭血压测量
const uint8_t Bp_Close[]=
{0xc8,0xd7,0xb6,0xa5,0x90,0x00,0x00,0x00,
0x00,0x00,0x00,0x00,0x00,0x00,0x00,0x00,
0x00,0x00,0x00,0x00,0x00,0x00,0x00,0x00};

//获取血压测量结果
const uint8_t Bp_Result[]=
{0xc8,0xd7,0xb6,0xa5,0x90,0x02,0x00,0x00,
0x00,0x00,0x00,0x00,0x00,0x00,0x00,0x00,
0x00,0x00,0x00,0x00,0x00,0x00,0x00,0x00};

//开启心率测量
const uint8_t Rate_Open[]=
{0xc8,0xd7,0xb6,0xa5,0xD0,0x01,0x00,0x00,
0x00,0x00,0x00,0x00,0x00,0x00,0x00,0x00,
0x00,0x00,0x00,0x00,0x00,0x00,0x00,0x00};

//关闭心率测量
const uint8_t Rate_Close[]=
{0xc8,0xd7,0xb6,0xa5,0xD0,0x00,0x00,0x00,
0x00,0x00,0x00,0x00,0x00,0x00,0x00,0x00,
0x00,0x00,0x00,0x00,0x00,0x00,0x00,0x00};

//获取心率测量结果
const uint8_t Rate_Result[]=
{0xc8,0xd7,0xb6,0xa5,0xD0,0x02,0x00,0x00,
0x00,0x00,0x00,0x00,0x00,0x00,0x00,0x00,
0x00,0x00,0x00,0x00,0x00,0x00,0x00,0x00};

//获取ADC 数据
const uint8_t Get_Adc[]=
{0xc8,0xd7,0xb6,0xa5,0x91,0x00,0x00,0x00,
0x00,0x00,0x00,0x00,0x00,0x00,0x00,0x00,
0x00,0x00,0x00,0x00,0x00,0x00,0x00,0x00};

//设置低功耗
const uint8_t Set_Powersaving[]=
{0xc8,0xd7,0xb6,0xa5,0x70,0x01,0x00,0x00,
0x00,0x00,0x00,0x00,0x00,0x00,0x00,0x00,
0x00,0x00,0x00,0x00,0x00,0x00,0x00,0x00};

//获取版本信息
const uint8_t Get_Version[]=
{0xc8,0xd7,0xb6,0xa5,0xa2,0x02,0x00,0x00,
0x00,0x00,0x00,0x00,0x00,0x00,0x00,0x00,
0x00,0x00,0x00,0x00,0x00,0x00,0x00,0x00};

static uint8_t HP6_Send_buff[buff_lenth] = {0};//发送数据缓存区
static uint8_t HP6_Result_buff[buff_lenth] = {0};//接收数据缓存区
/*
函数名:HP6_Init
函数的功能：HP6初始化
参数：无
*/
void HP6_Init(void)
{
	GPIO_InitTypeDef GPIO_HP6_Init;//定义结构体变量
	RCC_AHB1PeriphClockCmd(RCC_AHB1Periph_GPIOC,ENABLE);//打开GPIOC时钟
	GPIO_HP6_Init.GPIO_Pin=GPIO_Pin_13;//设置对应引脚--PC13
	GPIO_HP6_Init.GPIO_Mode=GPIO_Mode_OUT;//设置对应IO口为输出模式
	GPIO_HP6_Init.GPIO_OType=GPIO_OType_PP;//设置对应IO口为推挽模式
	GPIO_HP6_Init.GPIO_PuPd=GPIO_PuPd_NOPULL;//设置对应IO口为浮空模式
	GPIO_HP6_Init.GPIO_Speed=GPIO_Speed_50MHz;//设置对应IO口速度为50MHZ模式
	GPIO_Init(GPIOC,&GPIO_HP6_Init);//初始化GPIOC口
	hp_6_Power(0);
}
/*
函数名:Crc16
函数的功能：HP6初始化
参数：data,要检验的数据 len,要检验数据的长度
返回检验值
*/
uint16_t Crc16(uint8_t *data,uint16_t len)
{
    uint16_t crc16 = 0xFFFF;
    uint32_t uIndex ; //CRC查询表索引
    while (len --)
    {
        uIndex = (crc16&0xff) ^ ((*data) & 0xff) ; //计算CRC
				data = data + 1;
        crc16 = ((crc16>>8) & 0xff) ^ crc16_tab[uIndex];
    }
    return crc16 ;//返回CRC校验值
}

void HP6_IIC_Write(uint8_t *data)
{
	u8 i=0;
	IIC_Start(0);//0-PA,1-PB
	IIC_SendByte(0,hp6_addr<<1);//0-PA,1-PB
	for(i=0;i<buff_lenth;i++)
	{
		IIC_SendByte(0,*(data+i));//0-PA,1-PB
	}
	IIC_Stop(0);//0-PA,1-PB
}
void HP6_IIC_Read(uint8_t *data)
{
	u8 i=0;
	IIC_Start(0);
	IIC_SendByte(0,(hp6_addr<<1)|0x01);
	for(i=0;i<23;i++)
	{
		*(data+i)=IIC_ReadByte(0,0);
	}
	*(data+23)=IIC_ReadByte(0,1);//第23位数据无需应答
	IIC_Stop(0);
}

//得到返回的数据,避免HP6_Result_buff在其他外部.c中被引用
void HP6_Get_ResultDate(uint8_t *data)
{
	u8 i;
	for(i=0;i<buff_lenth;i++)
	{
		data[i]=HP6_Result_buff[i];
	}
}
//发送命令到从机并获取
//返回1 校验成功,返回0 校验失败
uint8_t HP6_Send_Get(uint8_t *HP6_Send_buff,uint8_t *HP6_Result_buff)
{
	uint16_t crc;
	crc = Crc16(&HP6_Send_buff[4],18); //数据校验
  *(uint16_t*)(&HP6_Send_buff[22]) = crc;
	HP6_IIC_Write(HP6_Send_buff); //发送命令
	Delay_nms(5); //读写间隔延时
	HP6_IIC_Read(HP6_Result_buff); //读取返回值
	crc = *(uint16_t*)(&HP6_Result_buff[22]); //校验确定都回来的是否为有效数据
  if(crc==Crc16(&HP6_Result_buff[4],18))//校验成功
	return 1;
	else
	return 0;
}
//开启心率测量
uint8_t HP6_Open_Rate(void)
{
	u8 i=0;
	hp_6_Power(0);
	for(i=0;i<buff_lenth;i++)
  HP6_Send_buff[i]=Rate_Open[i];
  return HP6_Send_Get(HP6_Send_buff,HP6_Result_buff);
}
//获取心率测量结果
uint8_t HP6_Get_RateDate(void)
{
	u8 i=0;
	for(i=0;i<buff_lenth;i++)
  HP6_Send_buff[i]=Rate_Result[i];
  return HP6_Send_Get(HP6_Send_buff,HP6_Result_buff);
}
//关闭心率测量
uint8_t HP6_Close_Rate(void)
{
	u8 i=0;
	for(i=0;i<buff_lenth;i++)
  HP6_Send_buff[i]=Rate_Close[i];
	hp_6_Power(1);
  return HP6_Send_Get(HP6_Send_buff,HP6_Result_buff);
}
//开启血压测量
uint8_t HP6_Open_BP(void)
{
	u8 i=0;
	hp_6_Power(0);
	for(i=0;i<buff_lenth;i++)
  HP6_Send_buff[i]=BP_Open[i];
  return HP6_Send_Get(HP6_Send_buff,HP6_Result_buff);
}
//获取血压测量结果
uint8_t HP6_Get_BPDate(void)
{
	u8 i=0;
	for(i=0;i<buff_lenth;i++)
  HP6_Send_buff[i]=Bp_Result[i];
  return HP6_Send_Get(HP6_Send_buff,HP6_Result_buff);
}
//关闭血压测量
uint8_t HP6_Close_BP(void)
{
	u8 i=0;
	for(i=0;i<buff_lenth;i++)
  HP6_Send_buff[i]=Bp_Close[i];
	hp_6_Power(1);
  return HP6_Send_Get(HP6_Send_buff,HP6_Result_buff);
}
//设置低功耗模式
uint8_t HP6_Power_Saving(void)
{
	u8 i=0;
	for(i=0;i<buff_lenth;i++)
  HP6_Send_buff[i]=Set_Powersaving[i];
  return HP6_Send_Get(HP6_Send_buff,HP6_Result_buff);
}
//获取版本信息
uint8_t HP6_Get_Version(void)
{
	u8 i=0;
	for(i=0;i<buff_lenth;i++)
  HP6_Send_buff[i]=Get_Version[i];
  return HP6_Send_Get(HP6_Send_buff,HP6_Result_buff);
}
